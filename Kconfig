## Kconfig
```kconfig
# Copyright (c) 2011, 2012, 2013, 2014 by Lawrence Livermore National Security, LLC. LLNL-CODE-645430 
# Produced at the Lawrence Livermore National Laboratory.
# Written by Kathleen Shoga and Barry Rountree (shoga1|rountree@llnl.gov).
# All rights reserved.
#
# This file is part of msr-safe.
#
# msr-safe is free software: you can redistribute it and/or 
# modify it under the terms of the GNU Lesser General Public 
# License as published by the Free Software Foundation, either 
# version 3 of the License, or (at your option) any
# later version.
#
# msr-safe is distributed in the hope that it will be useful, but 
# WITHOUT ANY WARRANTY; without even the implied warranty of 
# MERCHANTABILITY or FITNESS FOR A PARTICULAR PURPOSE. See the GNU 
# Lesser General Public License for more details.
#
# You should have received a copy of the GNU Lesser General Public 
# License along
# with msr-safe. If not, see <http://www.gnu.org/licenses/>.
#
# This material is based upon work supported by the U.S. Department
# of Energy's Lawrence Livermore National Laboratory. Office of 
# Science, under Award number DE-AC52-07NA27344.

config X86_MSR_SAFE
	tristate "/dev/cpu/*/msr_safe - Safe model-specific register support"
	depends CONFIG_X86_64
	---help---
	This device gives sanitized access to many of the x86
	Model-Specific Registers (MSRs).  It is a character device with
	major 202 and minors 0 to 31 for /dev/cpu/0/msr_safe to
	/dev/cpu/31/msr_safe.
	MSR accesses are directed to a specific CPU on multi-processor
	systems.
```
